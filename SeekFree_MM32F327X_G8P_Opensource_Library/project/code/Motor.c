/*******************************************************************************
电机相关
*******************************************************************************/


#include "zf_common_headfile.h"


/**********************************************************/
/*[S] 电机驱动 [S]----------------------------------------*/
/**********************************************************/

// 电机驱动(DRV8701)引脚初始化
void Motor_init (void)
{
    gpio_init(MOTOR_1_DIR_PIN, GPO, GPIO_LOW, GPO_PUSH_PULL);
    gpio_init(MOTOR_2_DIR_PIN, GPO, GPIO_LOW, GPO_PUSH_PULL);
    pwm_init(MOTOR_1_PWM_CHANNEL, MOTOR_PWM_FREQ, 0);
    pwm_init(MOTOR_2_PWM_CHANNEL, MOTOR_PWM_FREQ, 0);
}

//----------------------------------------------------------
// 函数简介     设置电机速度
// 使用示例     Motor_Set(1, 2500);
// 参数说明     motor范围：1-2
// 参数说明     duty范围：-10000~10000（注：duty本意是没有负数的）
//----------------------------------------------------------
void Motor_Set (uint8 motor, int16 duty)
{
    gpio_pin_enum    dir_pin;// 方向引脚
    pwm_channel_enum pwm_ch;// PWM引脚

    if(motor == 1) // 电机1 (左)
    {
        dir_pin = MOTOR_1_DIR_PIN;
        pwm_ch  = MOTOR_1_PWM_CHANNEL;
    }
    else // 电机2 (右)
    {
        dir_pin = MOTOR_2_DIR_PIN;
        pwm_ch  = MOTOR_2_PWM_CHANNEL;
		duty = -duty;
    }

    if(duty > 0)
    {
        gpio_high(dir_pin);
    }
    else
    {
        gpio_low(dir_pin);
        duty = -duty;
    }

    if(duty > PWM_DUTY_MAX) // 限幅
    {
        duty = PWM_DUTY_MAX;
    }

    pwm_set_duty(pwm_ch, (uint16)duty);
}

// 电机速度归零
void Motor_ALL_Zero(void)
{
    Motor_Set(1,0);
    Motor_Set(2,0);
}
/**********************************************************/
/*----------------------------------------[E] 电机驱动 [E]*/
/**********************************************************/


/**********************************************************/
/*[S] 编码器 [S]------------------------------------------*/
/**********************************************************/

// 左右编码器计数值全局变量
int ENC_left_CNT = 0;
int ENC_right_CNT = 0;
// // 左右编码器累加值全局变量
// 似乎不方便做防溢出？
// int ENC_left_SUM = 0;
// int ENC_right_SUM = 0;
/**********************************************************/
/*------------------------------------------[E] 编码器 [E]*/
/**********************************************************/
